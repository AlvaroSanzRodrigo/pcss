#include <Wire.h>
#include <Adafruit_GFX.h>
#include <Adafruit_SSD1306.h>

#define SCREEN_WIDTH 128
#define SCREEN_HEIGHT 32
#define OLED_RESET -1
Adafruit_SSD1306 display(SCREEN_WIDTH, SCREEN_HEIGHT, &Wire, OLED_RESET);

int centerX = SCREEN_WIDTH / 2;
int centerY = SCREEN_HEIGHT / 2;
int radius = 8;
int dotCount = 8;
int dotRadius = 1;

const uint8_t bitmap[] PROGMEM= {
   0x00, 0x00, 0x00, 0x00, 0x00, 0x00, 0x00, 0x00, 0x00, 0x00, 0x00, 0xe0,
   0xff, 0xff, 0xff, 0x0f, 0x00, 0x00, 0x00, 0x00, 0x00, 0x00, 0x00, 0x80,
   0x7f, 0x00, 0x00, 0xe0, 0xff, 0xff, 0xff, 0x0f, 0xe0, 0x01, 0x60, 0x00,
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   0x00, 0x00, 0x00, 0x00, 0x00, 0x00, 0x00, 0x00 };

String data[5] = {"N/A", "N/A", "N/A", "N/A", "N/A"};

void setup() {
  Serial.begin(9600);
  if(!display.begin(SSD1306_SWITCHCAPVCC, 0x3C)) {
    Serial.println(F("SSD1306 allocation failed"));
    while(1);
  }
  // Set the duration of the animation in milliseconds
  int animationDuration = 3000; 
  unsigned long startTime = millis();

  // ANIMATION
  while (millis() - startTime < animationDuration) {
    display.clearDisplay();
    display.display(); // Display the black frame
    for (int i = 0; i < dotCount; i++) {
      float angle = -PI / 2 + 2 * PI * i / dotCount; // starting angle is -PI/2
      int x = centerX + radius * cos(angle);
      int y = centerY + radius * sin(angle);

      display.fillCircle(x, y, dotRadius, WHITE);
      display.display();
      delay(100);
    }
  }
  display.clearDisplay();
  display.display();
  display.setCursor(0, 0);
  display.setTextSize(1);
  display.setTextColor(WHITE);
}
void readSerial() {
  for (int i = 0; i < 5; i++) {
    String value = Serial.readStringUntil(',');  //read until timeout
    value.trim();
    data[i] = value;
  }
}
void displayLogo() {
  display.clearDisplay();
  display.drawXBitmap(0, 0, bitmap, SCREEN_WIDTH, SCREEN_HEIGHT, WHITE);
  display.display();
}
void displayData() {
  display.clearDisplay(); // clear display
  display.setCursor(0, 0);
  display.println("CPU:" + data[0] + "C" + data[1] + "%");
  display.println("GPU:" + data[2] + "C" + data[3] + "%");
  display.println("RAM:" + data[4] + "%");
  display.display();
}
void useDisplay(){
  if(data[0] == "N/A") {
    displayLogo();
  } else {
    displayData();
  }
}
void loop() {
    useDisplay();
    while (Serial.available() != 0) {
      readSerial();
    }
}